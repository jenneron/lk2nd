// SPDX-License-Identifier: GPL-2.0-only

/dts-v1/;

/include/ "skeleton.dtsi"

/ {
	model = "Samsung Galaxy Tab Pro 8.4";
	compatible = "samsung,mondrianwifi", "qcom,msm8974", "lk2nd,device";

	qcom,msm-id = <0xb801ff01 0x08 0x00>;

	lk2nd,match-cmdline = "* samsung.hardware=SM-T320 samsung.board_rev=11 *";
};
